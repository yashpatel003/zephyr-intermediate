## CMakeLists.txt
```
cmake_minimum_required(VERSION 3.20.0)

find_package(Zephyr REQUIRED HINTS $ENV{ZEPHYR_BASE})

project(isolation_hw)

target_sources(app PRIVATE
    src/main.c
    src/credentials.c
    src/parser.c
)
```

## prj.conf
```kconfig
CONFIG_PRINTK=y
CONFIG_LOG=y

# Enable memory protection and user-mode thread isolation
CONFIG_USERSPACE=y
```

## src/main.c
```c
#include <zephyr/kernel.h>
#include <stdio.h>
#include <string.h>
#include "credentials.h"
#include "parser.h"

#define PARSER_STACK_SIZE 2048

K_THREAD_STACK_DEFINE(parser_stack, PARSER_STACK_SIZE);
static struct k_thread parser_thread;

static void parser_entry(void *attack_index, void *p2, void *p3)
{
    char packets[3][32];

    strcpy(packets[0], "get=0");
    snprintf(packets[1], sizeof(packets[1]), "get=%ld",
             (long)attack_index);
    snprintf(packets[2], sizeof(packets[2]), "get=%ld",
             (long)attack_index + 1);

    for (int i = 0; i < ARRAY_SIZE(packets); i++) {
        printk("parser: received '%s'\n", packets[i]);
        parse_command(packets[i]);
    }
}

int main(void)
{
    long attack_index =
        ((const char *)credentials_key_addr() -
         (const char *)parser_settings_addr()) / SETTING_SIZE;

    k_thread_create(&parser_thread,
                    parser_stack,
                    PARSER_STACK_SIZE,
                    parser_entry,
                    (void *)attack_index,
                    NULL,
                    NULL,
                    5,
                    K_USER,
                    K_NO_WAIT);

    return 0;
}
```

## src/credentials.c
```c
#include <zephyr/toolchain.h>
#include "credentials.h"

/*
 * Not const: a const array goes to flash, which user threads can read.
 * Aligned like the settings table entries, so the key sits at a whole entry index.
 */
static char device_key[32] __aligned(16) = "EC-PRIVATE-KEY:8f3a91c25d7e04b6";

/* Only used by main to simulate an attacker who knows the key's address. */
const void *credentials_key_addr(void)
{
	return device_key;
}
```

## src/credentials.h
```c
#ifndef CREDENTIALS_H
#define CREDENTIALS_H

/* Returns the address of the stored device key. */
const void *credentials_key_addr(void);

#endif
```

## src/parser.c
```c
#include <zephyr/kernel.h>
#include <stdlib.h>
#include <string.h>
#include "parser.h"

/* Const, so it is in flash: readable by the parser with or without isolation. */
static const char settings[][SETTING_SIZE] __aligned(16) = {
	"led=off",
	"interval=10",
	"mode=auto",
};

/*
 * Parses one command received from the network.
 * Supported command: "get=<n>", returns setting number n.
 */
void parse_command(const char *cmd)
{
	if (strncmp(cmd, "get=", 4) == 0) {
		long index = strtol(cmd + 4, NULL, 10);
		char value[SETTING_SIZE];

		/* Bug: the index comes from the packet and is not checked against the table size. */
		memcpy(value, settings[index], sizeof(value));
		printk("parser: setting %ld = %.16s\n", index, value);
		return;
	}

	printk("parser: unknown command '%s'\n", cmd);
}

/* Only used by main to simulate an attacker who knows the table's address. */
const void *parser_settings_addr(void)
{
	return settings;
}
```

## src/parser.h
```c
#ifndef PARSER_H
#define PARSER_H

#define SETTING_SIZE 16

/* Parses one command received from the network. */
void parse_command(const char *cmd);

/* Returns the address of the settings table. */
const void *parser_settings_addr(void);

#endif
```
